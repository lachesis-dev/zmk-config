## boards/shields/thorium34/Kconfig.defconfig
```kconfig
if SHIELD_THORIUM34_LEFT || SHIELD_THORIUM34_RIGHT
    config ZMK_SPLIT
        default y

    config ZMK_BLE
        default y
endif

if SHIELD_THORIUM34_LEFT
    config ZMK_SPLIT_ROLE_CENTRAL
        default y

    config ZMK_KEYBOARD_NAME
        default "Thorium34"

    config ZMK_USB
        default y
endif

if SHIELD_THORIUM34_RIGHT
    config ZMK_USB
        default n
endif
```

## boards/shields/thorium34/Kconfig.shield
```kconfig
config SHIELD_THORIUM34_LEFT
    def_bool $(shields_list_contains,thorium34_left)

config SHIELD_THORIUM34_RIGHT
    def_bool $(shields_list_contains,thorium34_right)
```

## boards/shields/totem/Kconfig.defconfig
```kconfig
if SHIELD_TOTEM_LEFT || SHIELD_TOTEM_RIGHT || SHIELD_TOTEM_DONGLE
    config ZMK_SPLIT
        default y

    config ZMK_BLE
        default y
endif

if SHIELD_TOTEM_DONGLE
    config ZMK_SPLIT_ROLE_CENTRAL
        default y
  
    config ZMK_SPLIT_BLE_CENTRAL_PERIPHERALS
        default 2
  
    # Dongle name
    config ZMK_KEYBOARD_NAME
        default "Totem Dongle"

endif

if SHIELD_TOTEM_LEFT || SHIELD_TOTEM_RIGHT
    config ZMK_SPLIT_ROLE_CENTRAL
        default n

    # Peripheral name (optional)
    config ZMK_KEYBOARD_NAME
        default "Totem"
endif
```

## config/west.yml
```yaml
manifest:
  remotes:
    - name: zmkfirmware
      url-base: https://github.com/zmkfirmware
    - name: caksoylar
      url-base: https://github.com/caksoylar
    - name: rschenk
      url-base: https://github.com/rschenk
  projects:
    - name: zmk
      remote: zmkfirmware
      revision: v0.3
      import: app/west.yml

    - name: zmk-smart-toggle
      remote: caksoylar
      revision: v0.3

    - name: zmk-rgbled-widget
      remote: caksoylar
      revision: v0.3

    - name: zmk-component-raytac-dongle
      remote: rschenk
      revision: v0.3
  self:
    path: config
```
